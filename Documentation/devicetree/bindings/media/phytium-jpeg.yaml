## Documentation/devicetree/bindings/media/phytium-jpeg.yaml
```yaml
# SPDX-License-Identifier: (GPL-2.0-only OR BSD-2-Clause)
%YAML 1.2
---
$id: http://devicetree.org/schemas/media/phytium-jpeg.yaml#
$schema: http://devicetree.org/meta-schemas/core.yaml#

title: Phytium JPEG Encoder driver

maintainers:
  - Chen Baozi <chenbaozi@phytium.com.cn>
allOf:
  - $ref: /schemas/media/phytium-jpeg.yaml#
properties:
  compatible:
    const: phytium,jpeg
  reg:
    minItems: 1
    items:
      - description: contains the offset and length of the JPEG Engine memory region

  interrupts:
    maxItems: 1
    items:
      - description: the interrupt associated with the VE on this platform

  phytium,ocm-buf-addr:
    minItems: 1
    items:
      - description: the physical address used to storage the inputing video data
unevaluatedProperties: false

required:
    - compatible
    - reg
    - interrupts
    - phytium,ocm-buf-addr

examples:
    - |
      jpeg: jpeg@32b32000 {
            compatible = "phytium,jpeg";
            reg = <0x0 0x32b32000 0 0x1000>;
            interrupts = <0 41 4>;
            phytium,ocm-buf-addr = <0x30c40000 0x30c60000>;
            status = "okay";
                        };
...
```

## Documentation/devicetree/bindings/mmc/phytium,mci.yaml
```yaml
# SPDX-License-Identifier: GPL-2.0-only
%YAML 1.2
---
$id: http://devicetree.org/schemas/mmc/phytium,mci.yaml#
$schema: http://devicetree.org/meta-schemas/core.yaml#

title: Phytium Multimedia Card Interface controller Binding

maintainers:
  - Chen Baozi <chenbaozi@phytium.com.cn>
  - Malloy Liu <liuqi1610@phytium.com.cn>

allOf:
  - $ref: mmc-controller.yaml#

properties:
  compatible:
    enum:
      - phytium,mci

  reg:
    maxItems: 1

  interrupts:
    minItems: 1
    maxItems: 1

  clocks:
    minItems: 1
    items:
      - description: core clock

  clock-names:
    minItems: 1
    items:
      - const: phytium_mci_clk

required:
  - compatible
  - reg
  - clocks
  - clock-names
  - interrupts

unevaluatedProperties: false

Examples:
	- Within .dtsi:
	mmc0: mmc@28000000 {
		compatible = "phytium,mci";
		reg = <0x0 0x28000000 0x0 0x1000>;
		interrupts = <GIC_SPI 72 IRQ_TYPE_LEVEL_HIGH>;
		clocks = <&sysclk_1200mhz>;
		clock-names = "phytium_mci_clk";
		status = "disabled";
	};

	- Within dts:
	&mmc0 {
		bus-width = <4>;
		max-frequency = <50000000>;
		cap-sdio-irq;
		cap-sd-highspeed;
		sd-uhs-sdr12;
		sd-uhs-sdr25;
		sd-uhs-sdr50;
		no-mmc;
		status = "ok";
	};
```

## Documentation/devicetree/bindings/mtd/phytium-nand.yaml
```yaml
# SPDX-License-Identifier: GPL-2.0
%YAML 1.2
---
$id: http://devicetree.org/schemas/mtd/phytium-nand.yaml#
$schema: http://devicetree.org/meta-schemas/core.yaml#

title: Phytium Random Number Generator

maintainers:
      - Chen Baozi <chenbaozi@phytium.com.cn>
properties:
  compatible:
    const: phytium,nand
reg:
    minItems: 1
    items:
      - desceiption:Offset and length of the register set of this block

required:
  - compatible
  - reg

additionalProperties: false
examples:
  - |
   nand0@0x28002000 {
       compatible = "phytium,nfc";
       reg = <0x0 0x28002000 0x0 0x1000>;
     };
```

## Documentation/devicetree/bindings/pci/phytium,pd2008-pcie-ep.yaml
```yaml
# SPDX-License-Identifier: (GPL-2.0-only OR BSD-2-Clause)
%YAML 1.2
---
Example:

ep0: ep@0x29030000 {
        compatible = "phytium,pd2008-pcie-ep";
        reg = <0x0 0x29030000 0x0 0x10000>,
              <0x11 0x00000000 0x1 0x00000000>,
              <0x0 0x29101000 0x0 0x1000>;
        reg-names = "reg", "mem", "hpb";
        max-outbound-regions = <3>;
        max-functions = /bits/ 8 <1>;
};
```

## arch/x86/Kconfig.fpu
```kconfig
# SPDX-License-Identifier: GPL-2.0

choice
	prompt "X86_Hygon_LMC"
  depends on X86_64 && CPU_SUP_HYGON
	default X86_Hygon_LMC_OFF

config X86_Hygon_LMC_OFF
	bool "Turn off large memory copy optimization for Hygon processors"
	help
    When this feature is enabled, we will trun off large memory copy optimization.

config X86_Hygon_LMC_SSE2_ON
	bool "Using sse2 nt copy for large memory copy"
	help
    When this feature is enabled, we will using copy_user_sse2_nt_string
	  for lagre memory copy.

config X86_Hygon_LMC_AVX2_ON
	bool "Using avx2 nt copy for large memory copy"
	help
	  When this feature is enabled, we will using copy_user_avx2_nt_string 
	  for lagre memory copy.

endchoice
```

## drivers/crypto/alibaba/alicc/Kconfig
```kconfig
config CRYPTO_DEV_ALICC
	tristate "Support for Alibaba cryptographic accelerator"
	depends on ARM64 && CRYPTO && CRYPTO_HW && PCI
	default n
	select CRYPTO_SKCIPHER
	select CRYPTO_LIB_DES
	select CRYPTO_AEAD
	select CRYPTO_AES
	select CRYPTO_CBC
	select CRYPTO_ECB
	select CRYPTO_CTR
	select CRYPTO_XTS
	select CRYPTO_SM4
	help
	  Enables the driver for the on-chip cryptographic accelerator of
	  Alibaba SoCs which is based on ARMv9 architecture.
	  If unsure say N.
```

## drivers/crypto/ycc/Kconfig
```kconfig
config CRYPTO_DEV_YCC
	tristate "Support for Alibaba YCC cryptographic accelerator"
	depends on CRYPTO && CRYPTO_HW && PCI
	default n
	select CRYPTO_SKCIPHER
	select CRYPTO_LIB_DES
	select CRYPTO_AEAD
	select CRYPTO_AES
	select CRYPTO_CBC
	select CRYPTO_ECB
	select CRYPTO_CTR
	select CRYPTO_XTS
	select CRYPTO_SM4
	help
	  Enables the driver for the on-chip cryptographic accelerator of
	  Alibaba Yitian SoCs which is based on ARMv9 architecture.
	  If unsure say N.
```

## drivers/gpu/drm/inspur/inspur-drm/Kconfig
```kconfig
config DRM_INSPUR
    tristate "DRM Support for Inspur"
    depends on DRM && PCI && MMU
    select DRM_KMS_HELPER
    select DRM_TTM
    help
	Choose this option if you have a Inspur soc chipset.If M is selected the
	module will be called inspur-drm.
```

## drivers/net/ethernet/wangxun/Kconfig
```kconfig
# SPDX-License-Identifier: GPL-2.0-only
#
# Wangxun network device configuration
#

config NET_VENDOR_WANGXUN
	bool "Wangxun devices"
	default y
	help
	  If you have a network (Ethernet) card belonging to this class, say Y.

	  Note that the answer to this question doesn't directly affect the
	  kernel: saying N will just cause the configurator to skip all
	  the questions about WangXun cards. If you say Y, you will be asked for
	  your specific card in the following questions.

if NET_VENDOR_WANGXUN

config TXGBE
	tristate "Wangxun(R) 10GbE PCI Express adapters support"
	depends on PCI
	imply PTP_1588_CLOCK
	help
	  This driver supports Wangxun(R) 10GbE PCI Express family of
	  adapters.

	  More specific information on configuring the driver is in
	  <file:Documentation/networking/device_drivers/ethernet/wangxun/txgbe.rst>.

	  To compile this driver as a module, choose M here. The module
	  will be called txgbe.

config NGBE
	tristate "Wangxun(R) 1GbE PCI Express adapters support"
	depends on PCI
	imply PTP_1588_CLOCK
	help
	  This driver supports Netswift gigabit ethernet adapters.
	  For more information on how to identify your adapter, go
	  to <http://www.net-swift.com>

	  To compile this driver as a module, choose M here. The module
	  will be called ngbe.

endif # NET_VENDOR_WANGXUN
```

## drivers/perf/thead/Kconfig
```kconfig
#PDX-License-Identifier: GPL-2.0-only
#
# Performance Monitor Drivers for THead M1 chip
#
config DWC_UNCORE_PCIE_PMU
	  tristate "Enable PMU support for the DesignWare PCI Express controller"
	  depends on ARM64
	  help
	    Enable perf support for the DesignWare PCI Express controller,
	    which provides time based analysis and event counters.
```

## drivers/phy/Kconfig.rej
```kconfig
--- drivers/phy/Kconfig
+++ drivers/phy/Kconfig
@@ -79,6 +79,7 @@ source "drivers/phy/rockchip/Kconfig"
 source "drivers/phy/samsung/Kconfig"
 source "drivers/phy/socionext/Kconfig"
 source "drivers/phy/st/Kconfig"
+source "drivers/phy/synopsys/Kconfig"
 source "drivers/phy/tegra/Kconfig"
 source "drivers/phy/ti/Kconfig"
 source "drivers/phy/intel/Kconfig"
```

## drivers/soc/alibaba/Kconfig
```kconfig
# SPDX-License-Identifier: GPL-2.0-only

menu "prefetch tuning drivers"

config ARM64_PREFETCH_TUNING
	tristate "arm64 prefetch tuning support"
	depends on ARM64
	help
	  In some scenarios, adjusting prefetch configuration can effectively
	  improve performance. This driver provides some interfaces related
	  to prefetch for sysctl to configure.

	  This option enables the support for arm64 prefetch tuning interface.

endmenu
```

## net/vtoa/Kconfig
```kconfig
# SPDX-License-Identifier: GPL-2.0-only

config VTOA
	tristate "VTOA: VPC TCP option address for AliYun"
	depends on NETFILTER
	depends on HOOKERS
	default m
	help
	  1. Support classic toa, obtains the source address and port from the
	     specific tcp option.

	  2. Support vpc toa, obtains the source address and port, vip, vport,
	     and vpc tunnel id as well.

	  3. Support IPv4 and IPv6.
```
